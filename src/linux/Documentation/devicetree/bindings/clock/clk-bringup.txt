## src/linux/Documentation/devicetree/bindings/clock/clk-bringup.txt
```
MediaTek CLK-BRINGUP
===============

The driver implements for bringup stage to turn on all clock.
It provides the clock node defined in
include/dt-bindings/clock/mt3612-clk.h

Required properties:
- compatible: Should be one of:
	- "mediatek,clk-bring-up"

Example:

	bring-up {
		compatible = "mediatek,clk-bring-up";
	}
```

## src/linux/Documentation/devicetree/bindings/clock/clk-freq-meter.txt
```
MediaTek CLK-FREQ-METER
===============

The driver implements to use cksys frequency meter hardware to measure clock.
It provides the software API defined in
include/soc/mediatek/mtk_freq_meter.h

Required properties:
- compatible: Should be one of:
	- "mediatek,mt3612-freq-meter"

Example:

	clk_freq_meter {
		compatible = "mediatek,mt3612-freq-meter";
	}
```

## src/linux/Documentation/devicetree/bindings/nvmem/mtk-efuse.txt
```
MediaTek nvmem driver
===============

The driver implements for nvmem framework in soc.

Required properties:
- compatible: Should be one of:
	- "mediatek,mt3612-efuse"

Example:

	efuse: efuse@11e40000 {
		compatible 	= "mediatek,mt3612-efuse";
		reg		= <0 0x11e40000 0 0x800>;
		...
		/* Data cells */
		phy_csi: phy_csi@180 {
			reg = <0x180 0x18>;
		};
	};


= Data consumers =
Are device nodes which consume nvmem data cells.

For example:

	tsens {
		...
		nvmem-cells = <&phy_csi>;
		nvmem-cell-names = "phy-csi";
	};
```

## src/linux/Documentation/devicetree/bindings/soc/mediatek/clk-allon.txt
```
MediaTek Clock-all-on
===============

The driver implements for bringup stage to turn on all clock in soc.
It provides the clock node defined in
include/dt-bindings/clock/mt3612-clk.h, mt3612-ep-clk.h.

Required properties:
- compatible: Should be one of:
	- "mediatek,clk-bring-up"

Example:

	bring-up {
		compatible = "mediatek,clk-bring-up";
		clocks = <&topckgen TOPCKGEN_SENINF_CG>;
		clock-names = "seninf_cg";
	};
```

## src/linux/Documentation/devicetree/bindings/soc/mediatek/clk-topon.txt
```
MediaTek Clock-top-on
===============

The driver enable fundamental clocks for top cksys,infra,peri in soc.
This clock's hardware default setting is all clock turn on.

Required properties:
- compatible: Should be one of:
	- "mediatek,infra-peri-cksys-clkon"

Example:

	top_clock {
		compatible = "mediatek,infra-peri-cksys-clkon";
		clocks = <&apmixedsys CLK_APMIXED_ARMPLL>;
		clock-names = "1";
	};
```

## src/linux/Documentation/devicetree/bindings/soc/mediatek/clk.txt
```
MediaTek Clock driver
===============

The driver implements for clock framework in soc.
It provides the clock node defined in
include/dt-bindings/clock/mt3612-clk.h, mt3612-ep-clk.h.

Required properties:
- compatible: Should be one of:
	- "mediatek,mt3612-apmixedsys"
	- "mediatek,mt3612-topckgen"
	- "mediatek,mt3612-infracfg"
	- "mediatek,mt3612-pericfg"
	- "mediatek,mt3612-mmsys-core"
	- "mediatek,mt3612-mmsys-gaze"
	- "mediatek,mt3612-mmsys-cmm"
	- "mediatek,mt3612-vpusys-vcore"
	- "mediatek,mt3612-vpusys-conn"
	- "mediatek,mt3612-vpusys-core0"
	- "mediatek,mt3612-vpusys-core1"
	- "mediatek,mt3612-vpusys-core2"
	- "mediatek,mt3612-audio-top"
	- "mediatek,mt3612-camsys-gz0"
	- "mediatek,mt3612-camsys-gz1"
	- "mediatek,mt3612-imgsys-gz0"
	- "mediatek,mt3612-imgsys-gz1"
	- "mediatek,mt3612-camsys-side0"
	- "mediatek,mt3612-camsys-side1"
	- "mediatek,mt3612-imgsys-side0"
	- "mediatek,mt3612-imgsys-side1"

Example:

	apmixedsys: clock-controller@10212000 {
		compatible = "mediatek,mt3612-apmixedsys";
		reg = <0 0x10212000 0 0x1000>;
		#clock-cells = <1>;
	};
```

## src/linux/Documentation/devicetree/bindings/soc/mediatek/lpddr.txt
```
MediaTek LPDDR
===============

The driver assign LPDDR register range.
LPDDR is SDRAM.

Required properties:
- compatible: Should be one of:
	- "mediatek,mt3612-lpddr"

Example:

	lpddr {
		compatible = "mediatek,mt3612-lpddr";
	};
```

## src/linux/Documentation/devicetree/bindings/soc/mediatek/pwrap-p2p.txt
```
MediaTek PMIC Wrapper P2P Driver

This document describes the binding for the MediaTek PMIC wrapper P2P.

Required properties in pwrap device node.
- compatible:
	"mediatek,mt3612-pmicw-p2p" for MT3612 SoCs
- reg: Must contain an entry for each entry in reg-names.

Optional properities:

Example:
		pmicw_p2p: pmicw_p2p@109CA000 {
			compatible = "mediatek,mt3612-pmicw-p2p";
			reg = <0 0x109CA000 0 0x0200>;
			status = "disabled";
		};
```

## src/linux/Documentation/devicetree/bindings/soc/mediatek/reset.txt
```
MediaTek Reset driver
===============

The driver implements reset driver
for toprgu (top reset generator unit).

Required properties:
- compatible: Should be one of:
	- "mediatek,mt3612-toprgu"

Example:

	toprgu: reset-controller@10211000 {
		compatible = "mediatek,mt3612-toprgu", "syscon";
		#reset-cells = <1>;
	};
```

## src/linux/Documentation/devicetree/bindings/soc/mediatek/scpsys-bringup.txt
```
MediaTek SCPSYS-BRINGUP
===============

The System Control Processor System (SCPSYS) has several power management
related tasks in the system. The tasks include thermal measurement, dynamic
voltage frequency scaling (DVFS), interrupt filter and lowlevel sleep control.
The System Power Manager (SPM) inside the SCPSYS is for the MTCMOS power
domain control.

The driver implements for bringup stage to turn on all power domain and the Generic PM domain bindings described in
power/power_domain.txt. It provides the power domains defined in
include/dt-bindings/power/mt8173-power.h ,mt2701-power.h,mt3611-power.h, and mt3612-power.h.

Required properties:
- compatible: Should be one of:
	- "mediatek,scpsys-bring-up0"
	- "mediatek,scpsys-bring-up1"
	- "mediatek,scpsys-bring-up2"
	- "mediatek,scpsys-bring-up3"
	- "mediatek,scpsys-bring-up4"
	- "mediatek,scpsys-bring-up5"
	- "mediatek,scpsys-bring-up6"
	- "mediatek,scpsys-bring-up7"
	- "mediatek,scpsys-bring-up8"
	- "mediatek,scpsys-bring-up9"
	- "mediatek,scpsys-bring-up10"
	- "mediatek,scpsys-bring-up11"
	- "mediatek,scpsys-bring-up12"
	- "mediatek,scpsys-bring-up13"
	- "mediatek,scpsys-bring-up14"
	- "mediatek,scpsys-bring-up15"
	- "mediatek,scpsys-bring-up16"
	- "mediatek,scpsys-bring-up17"
	- "mediatek,scpsys-bring-up18"
	- "mediatek,scpsys-bring-up19"
	- "mediatek,scpsys-bring-up20"
	- "mediatek,scpsys-bring-up21"


Example:

	bring-up-pd-vpu0 {
		compatible = "mediatek,scpsys-bring-up0";
		power-domains = <&scpsys MT3611_POWER_DOMAIN_VPU0>;
	};
	bring-up-pd-vpu1 {
		compatible = "mediatek,scpsys-bring-up";
		power-domains = <&scpsys MT3611_POWER_DOMAIN_VPU1>;
	};
```

## src/linux/Documentation/devicetree/bindings/soc/mediatek/scpsys.txt
```
MediaTek SCPSYS
===============

The System Control Processor System (SCPSYS) has several power management
related tasks in the system. The tasks include thermal measurement, dynamic
voltage frequency scaling (DVFS), interrupt filter and lowlevel sleep control.
The System Power Manager (SPM) inside the SCPSYS is for the MTCMOS power
domain control.

The driver implements the Generic PM domain bindings described in
power/power_domain.txt. It provides the power domains defined in
include/dt-bindings/power/mt8173-power.h.

Required properties:
- compatible: Should be one of:
        - "mediatek,mt8173-scpsys"
        - "mediatek,mt3612-scpsys"
	- "mediatek,mt3612ep-scpsys"
- #power-domain-cells: Must be 1
- reg: Address range of the SCPSYS unit
- infracfg: must contain a phandle to the infracfg controller
- clock, clock-names: clocks according to the common clock binding.
		      These are the clocks which hardware needs to be enabled
		      before enabling certain power domains.
        Required clocks for MT8173: "mm", "mfg", "venc" and "venc_lt"
        Reuqired clocks for MT3612: "topckgen", "mmsys_core", "mmsys_com",
                                    "mmsys_gaze", "camsys_side", "imgsys_side",
                                    "camsys_gz"

Example:

	scpsys: scpsys@10006000 {
		#power-domain-cells = <1>;
		compatible = "mediatek,mt8173-scpsys";
		reg = <0 0x10006000 0 0x1000>;
		infracfg = <&infracfg>;
		clocks = <&clk26m>,
			 <&topckgen CLK_TOP_MM_SEL>;
			 <&topckgen CLK_TOP_VENC_SEL>,
			 <&topckgen CLK_TOP_VENC_LT_SEL>;
		clock-names = "mfg", "mm", "venc", "venc_lt";
	};

Example consumer:

	afe: mt8173-afe-pcm@11220000 {
		compatible = "mediatek,mt8173-afe-pcm";
		power-domains = <&scpsys MT8173_POWER_DOMAIN_AUDIO>;
	};
```

## src/linux/Documentation/devicetree/bindings/usb/mtk-mtu3.txt
```
Mediatek SSUSB mtu3 SOC

The device node for Mediatek USB3.0 device controller

Required properties:
 - compatible: Must contain one of the following:
	- "mediatek,mt3611-mtu3"
	- "mediatek,mt3612-mtu3"
 - reg : specifies physical base address and size of the registers,
	the first one for MAC, the second for IPPC
 - interrupts : interrupt used by the controller
 - clocks : a list of phandle + clock-specifier pairs, one for each
	entry in clock-names
 - clock-names : must contain
	"sys_ck": for clock of device MAC




Example:
usb3dg: usbdg@112A0000 {
			compatible = "mediatek,mt3611-mtu3";
			reg = <0 0x112A1000 0 0x2dff>,
			      <0 0x112A3e00 0 0x0100>;
			interrupts = <GIC_SPI 129 IRQ_TYPE_LEVEL_LOW>;
			clock-names = "sys_ck", "free_ck";
			status = "disabled";
};
```

## src/linux/Documentation/devicetree/bindings/usb/mtk-xhci.txt
```
Mediatek SSUSB xHCI SOC

The device node for Mediatek SOC USB3.0 host controller

Required properties:
 - compatible: Must contain one of the following:
	- "mediatek,mt3611-xhci"
	- "mediatek,mt3612-xhci"
 - reg : specifies physical base address and size of the registers,
	the first one for MAC, the second for IPPC
 - interrupts : interrupt used by the controller
 - clocks : a list of phandle + clock-specifier pairs, one for each
	entry in clock-names
 - clock-names : must contain
	"sys_ck": for clock of xHCI MAC
	"wakeup_deb_p0": for USB wakeup debounce clock of port0
	"wakeup_deb_p1": for USB wakeup debounce clock of port1



Example:
usb3h: usbh@11200000 {
			compatible = "mediatek,mt3611-xhci";
			reg = <0 0x11200000 0 0x3dff>,
			      <0 0x11203e00 0 0x0100>;
			interrupts = <GIC_SPI 128 IRQ_TYPE_LEVEL_LOW>;
			clock-names = "sys_ck", "free_ck";
			status = "disabled";
};
```

## src/linux/Kconfig
```kconfig
#
# For a description of the syntax of this configuration file,
# see Documentation/kbuild/kconfig-language.txt.
#
mainmenu "Linux/$ARCH $KERNELVERSION Kernel Configuration"

config SRCARCH
	string
	option env="SRCARCH"

choice
	prompt "Choose Mediatek Machine define"
	depends on ARCH_MEDIATEK
	help
	  This option allows to select a Mediatek Machine config.

config MACH_FPGA
	bool "MACH_FPGA"
	help
	  Use this option for FPGA verification.

config MACH_MT3612_EMU
	bool "MACH_MT3612_EMU"
	help
	  Use this option for MT3612 emulator.

config MACH_MT3612_A0
	bool "MACH_MT3612_A0"
	help
	  Use this option for MT3612 A0.

endchoice

source "arch/$SRCARCH/Kconfig"
```
