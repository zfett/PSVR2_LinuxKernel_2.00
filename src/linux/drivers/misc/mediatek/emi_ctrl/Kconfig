## src/linux/drivers/misc/mediatek/emi_ctrl/Kconfig
```kconfig
config MTK_EMI_CTRL
	tristate "MediaTek EMI Control Driver"
	help
	  MediaTek EMI control driver.
```

## src/linux/drivers/misc/mediatek/gpu/Kconfig
```kconfig
config MTK_GPU_AXI_CTRL
	bool "Support GPU AXI control"
	depends on MTK_GPU_SUPPORT
	default n
	help
	  If support GPU AXI control or not.
	  AXI control is used to select GPU port to EMI.
	  It is for EMI verification.
	  It should be disable default.

config MTK_GPU_DEDICATED_FW_MEMORY
	bool "Support GPU FW memory on sysram"
	depends on MTK_GPU_SUPPORT
	default n
	help
	  If support GPU FW memory on sysram or not.
	  Make partial FW running on sysram to enhance performance.
	  If it is enable,
	  144k bytes of gpu sysram heap should be preserved for FW.

config MTK_GPU_DISABLE_HWPERF
	bool "Disable HWPerf function"
	depends on MTK_GPU_SUPPORT
	default n
	help
	  Used to disable HWPerf.
	  HWPerf is a profile function.
	  If HWPerf is disable,
	  PVRtune can't capture data.

config MTK_GPU_FW_MEMORY_START
	hex "GPU FW memory start address"
	depends on MTK_GPU_DEDICATED_FW_MEMORY
	default 0x0
	help
	  Defalt FW start address is 0x0.

config MTK_GPU_FW_MEMORY_SIZE
	hex "GPU FW memory size"
	depends on MTK_GPU_DEDICATED_FW_MEMORY
	default 0x24000
	help
	  Default FW size is 144K(0x24000).

config MTK_GPU_SUPPORT
	tristate "Support MediaTek GPU"
	depends on !MACH_MT3612EP
	default n
	help
	  config supports MediaTek GPU driver.
	  CONFIG_MTK_GPU_SUPPORT defines
	  if the gpu driver should be built in or not

config MTK_GPU_VERSION
	string "Support MTK GPU Driver Version"
	depends on MTK_GPU_SUPPORT
	default ""
	help
	  CONFIG_MTK_GPU_VERSION define which gpu ddk version will be used
	  It has three parts
	  1.vendor name 2. driver version

config MTK_GPU_LASCAR
	bool "Support Lascar GPU"
	depends on MTK_GPU_SUPPORT
	default n
	help
	  If use Lascar GPU or not.
	  It is used to select appropriate driver.
	  FPGA has to disable it.
	  PAPA and real chip have to enable it.

config MTK_GPU_COMMON_DVFS_SUPPORT
	bool "Support GPU DVFS Policy"
	depends on MTK_GPU_SUPPORT
	select PM_OPP
	select PM_DEVFREQ
	select DEVFREQ_GOV_SIMPLE_ONDEMAND
	select DEVFREQ_GOV_USERSPACE
	default n
	help
	  config supports to enable GPU DVFS policy.
	  Use devfreq framework.
	  It is nice method to save power.
	  If it is enable, the opp table on dts needs to be configured.
```

## src/linux/drivers/misc/mediatek/hal_tsp/Kconfig
```kconfig
config MTK_XTS_SMC
	tristate "MediaTek xts smc driver"
	help
	  Handle xts smc function
```

## src/linux/drivers/misc/mediatek/imgproc/Kconfig
```kconfig
config MTK_IMGPROC
	tristate "MediaTek Image Processing Support"
	help
	  MediaTek Image Processing Driver
	  This is an option to enable support for MediaTek
	  image processing drivers including CROP, LHC, P2S,
	  Padding, RDMA, Resizer, WarpA, and WDMA.

config MTK_CROP
	tristate "MediaTek Crop driver"
	depends on MTK_IMGPROC
	help
	  Crop module is used to crop Region-of-Interest (ROI)
	  to the nest module.this module input color format
	  is YUV444 10bit,output color format is YUV444 10 bit,
	  color range is input/output (0-1023/0-255).

config MTK_LHC
	tristate "MediaTek LHC driver"
	depends on MTK_IMGPROC && !MACH_MT3612EP
	help
	  The Local Histogram Counter (LHC) module is used to
	  generate R/G/B histogram for each local block. LHC
	  supports YUV444 & RGB data. The histogram processing
	  is based on RGB data.

config MTK_P2S
	tristate "MediaTek P2S driver"
	depends on MTK_IMGPROC
	help
	  The Parallel-To-Serial (P2S) module is used to
	  transfer a Left side and Right side of image into
	  a sideby-side image to be output. It can also support
	  Left relay mode and Right relay mode.

config MTK_PADDING
	tristate "MediaTek Padding driver"
	depends on MTK_IMGPROC && !MACH_MT3612EP
	help
	  Padding module is used to pad out boundary pixels
	  between side-by-side images.The padding engine is
	  for padding out horizontal pixels. Padding engine pads
	  out some pixel values in one quarter, two quarter and
	  three quarter of the horizontal line.

config MTK_RDMA
	tristate "MediaTek RDMA driver"
	depends on MTK_IMGPROC
	help
	  The RDMA module is used to read data from
	  SRAM or DRAM. This module support read only
	  Region-Of-Interest from SRAM or DRAM (cropping).
	  It can support to read data with some special
	  color formats.

config MTK_RSZ
	tristate "MediaTek Resizer driver"
	depends on MTK_IMGPROC
	help
	  Resizer module is a High fidelity scaler, used to
	  scaling the image, support both up and down scaling.
	  support input format as YUV444 10bit mode and support
	  scaling ratio from 1/128 to 64.

config MTK_WDMA
	tristate "MediaTek WDMA driver"
	depends on MTK_IMGPROC
	help
	  The WDMA module is used to transfer data into
	  SRAM or DRAM. this module also support simple
	  color format transformation and write only
	  Region-Of-Interest into SRAM or DRAM (cropping).

config MTK_WARPA
	tristate "MediaTek WPEA driver"
	depends on MTK_IMGPROC
	help
	  The Warp Engine Type-A (WPEA) is used to process lens
	  distortion in multimedia sub-system according warpmap
	  description. WPEA just process the Y channel (luminance)
	  of image.
```

## src/linux/drivers/misc/mediatek/ivp/Kconfig
```kconfig
config MTK_IVP
	tristate "Mediatek IVP driver"
	select DMA_SHARED_BUFFER
	select FRAME_VECTOR
	help
	  Support image processing using IVP hardware.
	  Open this config to use ivp hardware.
	  CONFIG_MTK_IVP defines
	  the ivp driver should be built in or not.

config MTK_IVP_DVFS
	bool "Mediatek IVP driver dvfs"
	select PM_OPP
	select PM_DEVFREQ
	select DEVFREQ_GOV_SIMPLE_ONDEMAND
	select DEVFREQ_GOV_USERSPACE
	help
	  Support IVP dvfs (Dynamic Voltage/Frequency Scaling).
	  Open this config to enable dvfs in IVP.
	  CONFIG_MTK_IVP_DVFS defines
	  if the ivp_dvfs driver should be opened or not.

config MTK_IVP_LOAD_ALGO_FROM_USER
	bool "Mediatek IVP driver load algo from user"
	default y
	help
	  Support IVP load algo from user.
	  Opend this config to enable loading algo from user space buffer.
	  CONFIG_MTK_IVP_LOAD_ALGO_FROM_USER defines
	  the ivp algo can be loaded from user space buffer or not.

config MTK_IVP_DEBUG_LOG
	bool "Mediatek IVP driver debug log"
	default n
	help
	  Support IVP debug log.
	  Opend this config to enable record some debug information.
	  CONFIG_MTK_IVP_DEBUG_LOG defines
	  the ivp kernel driver will be recorded some log information or not.
```

## src/linux/drivers/misc/mediatek/ldvt/Kconfig
```kconfig
config MTK_LDVT
	tristate "MediaTek Linux Design Verification Test"
	help
	  Mediatek Linux design verification test support
	  This is an option for use by developers; most people should
	  say N here. This enable the test program for Mediatek
	  device driver.

config MTK_DISP_PIPE
	tristate "MediaTek display pipe driver"
	depends on MTK_LDVT
	help
	  Display pipe integration driver.
	  This driver provide an example of how to use rdma/dsc/dsi... modules
	  to output image stream.

config MTK_CINEMATIC
        tristate "MediaTek cinematic path"
        depends on MTK_LDVT
        help
          Cinematic integration driver.
          This driver provide an example of how to display cinematic path.

config MTK_LATENCY
        tristate "MediaTek latency verify"
        depends on MTK_LDVT
        help
          Low Latency verify driver.
          This driver provide an example of how to verify the low latency.
```

## src/linux/drivers/misc/mediatek/mm_sysram/Kconfig
```kconfig
config MTK_MM_SYSRAM
	tristate "MediaTek MM_SYSRAM driver"
	help
	  MediaTek MultiMedia SYSRAM hardware. Enable for low latency
	  requirement when platform support. The driver provide
	  SYSRAM control for other multimedia drivers which include
	  Ring Buffer Control (RBFC) in their data path.
```

## src/linux/drivers/misc/mediatek/mmsys/Kconfig
```kconfig
config MTK_MMSYS
	tristate "MediaTek MMSys Support"
	depends on ARCH_MEDIATEK || COMPILE_TEST
	select MTK_INFRACFG
	help
	  This is MediaTek multimedia system (MMSys) core dirver.
	  It's used to configure the display path which contains the
	  necessary hardware components. A display path is used for a
	  special display scenario.

	  To compile this driver as a module, choose M here.
```

## src/linux/drivers/misc/mediatek/mutex/Kconfig
```kconfig
config MTK_MUTEX
	tristate "MediaTek MUTEX Support"
	depends on ARCH_MEDIATEK || COMPILE_TEST
	select MTK_INFRACFG
	help
	  Say yes here to add support for the MediaTek MUTEX driver.
	  The MUTEX is used to provide SOF/EOF sources to all hardware
	  modules in display pipeline.
```

## src/linux/drivers/misc/mediatek/pmic/Kconfig
```kconfig
#
# MTK PMIC configuration
#

config MTK_PMIC_NEW_ARCH
	tristate "MediaTek Power Management New Arch driver"
	default n
	---help---
	  This selects for MediaTek(R) PMIC New Arch driver.
	  Separate pmic feature form Power folder that also have battery and charging feature.
	  Select y to support MTK PMIC NEW ARCH.
	  If so, you should choose the corresponding main chip to follow.

	  Select n to support MTK PMIC LEGACY ARCH.

config MTK_PMIC_COMMON
	tristate "MediaTek Power Management Common driver"
	default n
	---help---
	  This selects for MediaTek(R) PMIC common driver.
	  This feature is mainly to separate to common and platform part from driver layer.
	  Select y to support MTK PMIC COMMON feature.
	  Set n and choose other chip.

config MTK_PMIC_CHIP_MT3615
	tristate "MediaTek PMIC MT3615 Driver"
	default n
	---help---
	  This selects for MediaTek(R) PMIC MT3615 driver.
	  It's main chip type and providing power features like auxadc,
	  buck/ldo, interrupt-controller..etc
	  Set y to support this driver.
	  Set n and choose other chip.


config MTK_PMIC_PWM_INTF
	bool "MediaTek PMIC PWM interface"
	depends on MTK_PMIC_NEW_ARCH
	default n
	---help---
	  MediaTek PMIC PWM interface Driver
	  only for MTK_PMIC_NEW_ARCH
	  Set y to enable it.
	  Set n to disable it.

config MTK_PMIC_CHIP_MT6355
	tristate "MediaTek PMIC MT6355 Driver"
	default n
	---help---
	  This selects for MediaTek(R) PMIC MT6355 driver.
	  It's main chip type and providing power features like auxadc,
	  buck/ldo, interrupt-controller..etc
	  Set y to support this driver.
	  Set n and choose other chip.

config MTK_AUXADC_INTF
	bool "MediaTek PMIC Auxadc interface"
	depends on MTK_PMIC_NEW_ARCH
	default n
	---help---
	  MediaTek PMIC Auxadc interface Driver
	  only for MTK_PMIC_NEW_ARCH
	  Set y to enable it.
	  Set n to disable it.
```

## src/linux/drivers/misc/mediatek/rbfc/Kconfig
```kconfig
config MTK_RBFC
	tristate "Mediatek RBFC driver"
	help
	  Ring buffer control hardware. Enable for low latency
	  requirement when platform support. The driver provide
	  rbfc hw control for other multimedia drivers which include
	  rbfc in their data path.
```

## src/linux/drivers/misc/mediatek/sbrc/Kconfig
```kconfig
config MTK_SBRC
	tristate "MediaTek SBRC driver"
	depends on !MACH_MT3612EP
	help
	  Strip Buffer Rendering Control hardware. It is proposed to
	  maintain the fullness and emptiness of strip buffers between
	  GPU (GPIO) and Ring Buffer Controller (RBFC_REN to RDMA).
```

## src/linux/drivers/misc/mediatek/scp/Kconfig
```kconfig
config MTK_SCP
	tristate "MediaTek SCP IPC driver"
	help
	  SCP is a MediaTek in-house DSP which can receive
	  command from IPI interface.
```

## src/linux/drivers/misc/mediatek/slicer/Kconfig
```kconfig
config MTK_SLICER
	tristate "Mediatek slicer driver"
	help
	  MTK Linux Driver for slicer.
	  This driver is used to configure MTK slicer hardware module.
	  It includes DP video and DSC path selection, frame and slice configuration
```

## src/linux/drivers/misc/mediatek/timestamp/Kconfig
```kconfig
config MTK_TIMESTAMP
	tristate "MediaTek timestamp driver"
	depends on !MACH_MT3612EP
	help
	  Provide timestamp of sources such as DSI and I2S.
```

## src/linux/drivers/misc/mediatek/top/Kconfig
```kconfig
config MTK_MMSYS_CMMN_TOP
	tristate "Mediatek mmsys common top driver"
	help
	  Connect two different modules in computer vision paths
	  and the display pipeline.

config MTK_MMSYS_GAZE_TOP
	tristate "Mediatek mmsys gaze top driver"
	help
	  For mmsys gaze hw modules reset and some debug.
```

## src/linux/drivers/phy/mediatek/Kconfig
```kconfig
#
# Phy drivers for Mediatek devices
#
config MTK_MIPI_TX
	tristate "Mediatek mipi tx driver"
	help
		MTK MIPI TX Linux Driver.
		This driver is used to configure MTK mipi tx hardware module.
		It includes pll setting, lane setting... and etc.

config PHY_MTK_USB_XSPHY
	tristate "MediaTek USB XS-PHY Driver"
	depends on ARCH_MEDIATEK && OF
	select GENERIC_PHY
	default n
	help
 		Say 'Y' here to add support for MediaTek USB XS-PHY driver,
		it supports multiple usb2.0, usb3.0/usb3.1 ports,
		the XS-PHY with shared banks between multi-ports.
		If unsure, say N.

config MTK_USB_PHY_PGAIN
	bool "MediaTek USB PHY CDR P-Gain Fine Tune"
	depends on PHY_MTK_USB_XSPHY
	default y
	help
	  Say 'Y' here to fine tune USB PHY CDR p-gain.
	  Say 'N' here not to fine tune USB PHY CDR p-gain.

config PHY_MTK_DPRX_PHY
	tristate "MediaTek DPRX PHY Driver"
	depends on ARCH_MEDIATEK && OF
	select GENERIC_PHY
	default n
	help
		Say 'Y' here to add support for MediaTek DPRX PHY driver.

config MT3612_DPRX_EFUSE
	bool "MediaTek DP-Rx eFuse for MT3612"
	depends on PHY_MTK_DPRX_PHY
	default n
	help
	  Say 'Y' here to load eFuse for mt3612
	  Say 'N' here to load eFuse for mt3611
```

## src/linux/drivers/pwm/mediatek/Kconfig
```kconfig
config PWM_MTK
	tristate "MediaTek PWM driver"
	default n
	help
	  PWM: pluse-width modulation.
	  PWM driver support for MediaTek SOC.
	  If you want to use MediaTek PWM driver, say Y or M here.
	  If unsure, say N.

config PWM_MTK_DEBUG
        bool "MediaTek PWM Ddebug driver"
        depends on PWM_MTK
        help
          PWM debug driver support for MediaTek SOC.
          If you want to debug MediaTek PWM driver, say Y or M here.
          If unsure, say N.
```
