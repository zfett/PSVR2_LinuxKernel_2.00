/*
 * Copyright (c) 2019 MediaTek Inc.
 *
 * This program is free software; you can redistribute it and/or modify
 * it under the terms of the GNU General Public License version 2 as
 * published by the Free Software Foundation.
 *
 * This program is distributed in the hope that it will be useful,
 * but WITHOUT ANY WARRANTY; without even the implied warranty of
 * MERCHANTABILITY or FITNESS FOR A PARTICULAR PURPOSE.  See the
 * GNU General Public License for more details.
 */

/dts-v1/;
#include "mt3612-a0-system.dtsi"
#include "mt3612-clkao.dtsi"
#include "mt3612-a0-peri.dtsi"
#include "mt3612-a0-peri-extra.dtsi"
#include "mt3612-a0-mm.dtsi"
#include "mt3612-a0-coresight.dtsi"
#include "mt3612-a0-camera.dtsi"
#include "mt3612-a0-camera-i2c.dtsi"
#include "mt3612-a0-test.dtsi"
#include "mt3615.dtsi"
#include "mt3612-a0.dtsi"
