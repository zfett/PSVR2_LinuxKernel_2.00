## src/linux/arch/arm64/configs/sie_release_nfs_mt3612_asic_a0_defconfig
```kconfig
CONFIG_MACH_MT3612_A0=y
CONFIG_SIE_PRINTK_CUSTOM_LOG_DRIVER=y
CONFIG_SIE_CRASH_DUMP_SUPPORT_FOR_USER=y
# CONFIG_LOCALVERSION_AUTO is not set
# CONFIG_SWAP is not set
CONFIG_SYSVIPC=y
CONFIG_FHANDLE=y
CONFIG_NO_HZ_IDLE=y
CONFIG_HIGH_RES_TIMERS=y
CONFIG_BSD_PROCESS_ACCT=y
CONFIG_BSD_PROCESS_ACCT_V3=y
CONFIG_LOG_BUF_SHIFT=19
CONFIG_BLK_DEV_INITRD=y
# CONFIG_RD_GZIP is not set
# CONFIG_RD_BZIP2 is not set
# CONFIG_RD_LZMA is not set
# CONFIG_RD_XZ is not set
# CONFIG_RD_LZO is not set
# CONFIG_RD_LZ4 is not set
CONFIG_CC_OPTIMIZE_FOR_SIZE=y
CONFIG_KALLSYMS_ALL=y
# CONFIG_AIO is not set
CONFIG_EMBEDDED=y
# CONFIG_VM_EVENT_COUNTERS is not set
# CONFIG_COMPAT_BRK is not set
CONFIG_JUMP_LABEL=y
CONFIG_CC_STACKPROTECTOR_STRONG=y
CONFIG_MODULES=y
# CONFIG_BLK_DEV_BSG is not set
CONFIG_PARTITION_ADVANCED=y
# CONFIG_MSDOS_PARTITION is not set
# CONFIG_IOSCHED_DEADLINE is not set
# CONFIG_IOSCHED_CFQ is not set
CONFIG_ARCH_MEDIATEK=y
# CONFIG_ARM64_ERRATUM_826319 is not set
# CONFIG_ARM64_ERRATUM_827319 is not set
# CONFIG_ARM64_ERRATUM_824069 is not set
# CONFIG_ARM64_ERRATUM_819472 is not set
# CONFIG_ARM64_ERRATUM_832075 is not set
# CONFIG_ARM64_ERRATUM_843419 is not set
# CONFIG_ARM64_ERRATUM_1024718 is not set
# CONFIG_CAVIUM_ERRATUM_22375 is not set
# CONFIG_CAVIUM_ERRATUM_23154 is not set
# CONFIG_CAVIUM_ERRATUM_27456 is not set
CONFIG_SCHED_MC=y
CONFIG_NR_CPUS=4
CONFIG_HOTPLUG_CPU=n
CONFIG_PREEMPT=y
# CONFIG_COMPACTION is not set
# CONFIG_BOUNCE is not set
# CONFIG_ARM64_HW_AFDBM is not set
# CONFIG_ARM64_PAN is not set
# CONFIG_EFI is not set
# CONFIG_CORE_DUMP_DEFAULT_ELF_HEADERS is not set
# CONFIG_SUSPEND is not set
CONFIG_PM=y
CONFIG_CPU_FREQ=y
CONFIG_CPU_FREQ_GOV_ONDEMAND=y
CONFIG_ARM_MT3612_CPUFREQ=y
CONFIG_NET=y
CONFIG_INET=y
CONFIG_DEVTMPFS=y
CONFIG_DEVTMPFS_MOUNT=y
CONFIG_CMA=n
CONFIG_MTD=n
CONFIG_MTK_COMPUTERVISION=y
CONFIG_MTK_FE=y
CONFIG_MTK_FM=y
CONFIG_MTK_DSC=y
CONFIG_MTK_DPRX=y
# CONFIG_MTK_DPRX_EDID is not set
CONFIG_MTK_DPRX_HDCP_KEY=y
CONFIG_MTK_DDDS=y
CONFIG_MTK_DSI=y
CONFIG_MTK_FRMTRK=y
CONFIG_MTK_GPU_DEDICATED_FW_MEMORY=y
CONFIG_MTK_GPU_SUPPORT=y
CONFIG_MTK_GPU_VERSION="rgx rogue_km"
CONFIG_MTK_GPU_LASCAR=y
CONFIG_MTK_GPU_COMMON_DVFS_SUPPORT=y
CONFIG_MTK_IMGPROC=y
CONFIG_MTK_CROP=y
CONFIG_MTK_LHC=y
CONFIG_MTK_P2S=y
CONFIG_MTK_PADDING=y
CONFIG_MTK_RDMA=y
CONFIG_MTK_RSZ=y
CONFIG_MTK_WDMA=y
CONFIG_MTK_WARPA=y
CONFIG_MTK_IVP=y
# CONFIG_MTK_IVP_LOAD_ALGO_FROM_USER is not set
CONFIG_MTK_MMSYS=y
CONFIG_MTK_MM_SYSRAM=y
CONFIG_MTK_MUTEX=y
CONFIG_MTK_PMIC_NEW_ARCH=y
CONFIG_MTK_PMIC_COMMON=y
CONFIG_MTK_PMIC_CHIP_MT3615=y
CONFIG_MTK_PMIC_PWM_INTF=y
CONFIG_MTK_RBFC=y
CONFIG_MTK_SBRC=n
CONFIG_MTK_SCP=y
CONFIG_MTK_SLICER=y
CONFIG_MTK_TIMESTAMP=y
CONFIG_MTK_MMSYS_CMMN_TOP=y
CONFIG_MTK_MMSYS_GAZE_TOP=n
CONFIG_NETDEVICES=y
CONFIG_USB_USBNET=y
# CONFIG_INPUT_MOUSEDEV is not set
CONFIG_INPUT_EVDEV=y
# CONFIG_KEYBOARD_ATKBD is not set
CONFIG_KEYBOARD_GPIO=y
# CONFIG_INPUT_MOUSE is not set
# CONFIG_SERIO_SERPORT is not set
# CONFIG_VT is not set
# CONFIG_UNIX98_PTYS is not set
CONFIG_LEGACY_PTY_COUNT=16
# CONFIG_DEVKMEM is not set
CONFIG_SERIAL_8250=y
CONFIG_SERIAL_8250_CONSOLE=y
CONFIG_SERIAL_8250_MT3611=y
CONFIG_SERIAL_8250_RUNTIME_UARTS=1
CONFIG_SERIAL_OF_PLATFORM=y
# CONFIG_HW_RANDOM is not set
CONFIG_I2C_CHARDEV=y
CONFIG_I2C_MT36XX=y
CONFIG_SPI=y
CONFIG_SPI_MT36XX=y
CONFIG_SPI_SPIDEV=y
CONFIG_GPIO_SYSFS=y
# CONFIG_HWMON is not set
CONFIG_WATCHDOG=y
CONFIG_MEDIATEK_WATCHDOG=y
CONFIG_MFD_MT3615_STATUS=y
CONFIG_REGULATOR=y
CONFIG_REGULATOR_FIXED_VOLTAGE=y
CONFIG_REGULATOR_MT3615=y
CONFIG_MEDIA_SUPPORT=y
CONFIG_MEDIA_CAMERA_SUPPORT=y
CONFIG_V4L_PLATFORM_DRIVERS=y
CONFIG_VIDEO_MEDIATEK_ISP=y
CONFIG_VIDEO_MEDIATEK_CCU=n
CONFIG_VIDEO_MEDIATEK_GCE=y
CONFIG_VIDEO_MEDIATEK_CAMERA_MEMORY=y
CONFIG_VIDEO_MEDIATEK_IMGSENSOR_V2=y
CONFIG_DRM=y
# CONFIG_HID is not set
# CONFIG_USB_HID is not set
CONFIG_USB=y
CONFIG_USB_XHCI_HCD=y
CONFIG_USB_XHCI_MTK=y
CONFIG_USB_MTU3=y
CONFIG_USB_MTU3_USB2_FS=y
CONFIG_USB_GADGET=y
CONFIG_USB_GADGET_VBUS_DRAW=500
CONFIG_USB_G_SERIAL=m
CONFIG_MMC=y
CONFIG_MMC_BLOCK_MINORS=32
CONFIG_MMC_MTK=y
CONFIG_STAGING=y
CONFIG_SYNC=y
CONFIG_SW_SYNC=y
CONFIG_SW_SYNC_USER=y
CONFIG_ION=y
CONFIG_ION_MTK=y
CONFIG_MAILBOX=y
CONFIG_MTK_IOMMU=y
CONFIG_MTK_PMIC_WRAP=y
CONFIG_MTK_DEBUGFS=n
CONFIG_PM_DEVFREQ=y
CONFIG_ARM_MT3612_DEVFREQ=y
CONFIG_PWM=y
CONFIG_PWM_MTK=y
CONFIG_RESET_CONTROLLER=y
CONFIG_MTK_MIPI_TX=y
CONFIG_PHY_MTK_USB_XSPHY=y
CONFIG_PHY_MTK_DPRX_PHY=y
CONFIG_MT3612_DPRX_EFUSE=y
CONFIG_ANDROID=y
CONFIG_NVMEM=y
# CONFIG_NVMEM_SUPPORT_USERLAND is not set
CONFIG_MTK_EFUSE=y
CONFIG_FANOTIFY=y
CONFIG_VFAT_FS=y
CONFIG_TMPFS=y
CONFIG_TMPFS_XATTR=y
CONFIG_CONFIGFS_FS=y
# CONFIG_MISC_FILESYSTEMS is not set
CONFIG_NFS_FS=y
CONFIG_NLS_CODEPAGE_437=y
CONFIG_NLS_ISO8859_1=y
CONFIG_PRINTK_TIME=y
CONFIG_MESSAGE_LOGLEVEL_DEFAULT=7
CONFIG_DEBUG_INFO=y
CONFIG_MAGIC_SYSRQ=y
CONFIG_DEBUG_KMEMLEAK=n
CONFIG_DEBUG_FS=n
CONFIG_LOCKUP_DETECTOR=y
CONFIG_PANIC_ON_OOPS=y
# CONFIG_SCHED_DEBUG is not set
# CONFIG_DEBUG_PREEMPT is not set
CONFIG_STRICT_DEVMEM=y
CONFIG_DEBUG_SET_MODULE_RONX=y
CONFIG_DEBUG_RODATA=y
CONFIG_CRYPTO=y
# CONFIG_CRYPTO_ECHAINIV is not set
CONFIG_ARM64_CRYPTO=y
CONFIG_CRYPTO_SHA2_ARM64_CE=y
CONFIG_VIDEO_MEDIATEK_ISP_TINY=y
CONFIG_MTK_DPRX_PHY_GCE=y
CONFIG_MTK_USB_PHY_PGAIN=y
```

## src/linux/drivers/clk/mediatek/Kconfig
```kconfig
#
# MediaTek SoC drivers
#
config COMMON_CLK_MEDIATEK
	bool
	---help---
	  Mediatek SoCs' clock support.

config COMMON_CLK_MT3612
	bool "Clock driver for Mediatek MT3612"
	depends on COMMON_CLK
	select COMMON_CLK_MEDIATEK
	default MACH_MT3612_A0
	---help---
	  This driver supports Mediatek MT3611 clocks.

config MTK_FREQ_METER_VERIFY
	tristate "Frequency meter for Mediatek MT3612"
	---help---
	  This driver use to measure actual clock frequency.
```

## src/linux/drivers/media/platform/mtk-cam/Kconfig
```kconfig
#
# Mediatek camera platform drivers.
#

config VIDEO_MEDIATEK_ISP
	tristate "Mediatek Image Signal Processor Driver"
	help
	  MTK Linux driver for ISP.
	  ISP is used to process image data from raw file
	  or sensor image data to YUV data through a variety
	  of image processing procedures.

config VIDEO_MEDIATEK_CCU
	tristate "Mediatek Camera Control Unit Driver"
	help
	  MTK Linux driver for CCU.
	  CCU is a dedicated control unit to execute AE and AWB
	  algorithm for performance requirement.

config VIDEO_MEDIATEK_GCE
	tristate "Mediatek Global Command Engine Driver"
	select MTK_CMDQ
	help
	  MTK Linux driver for ISP GCE
	  ISP is one of Global command Engine clients which
	  need GCE to achieve some flow control tasks.
	  This driver support for ISP driver manipulates GCE commands.

config VIDEO_MEDIATEK_CAMERA_MEMORY
	tristate "Mediatek Camera Memory Driver"
	help
	  MTK memory driver for camera.
	  Driver support for ISP and its related driver to
	  to access dram or sram, such as allocating memory buffer
	  for storing processed image data.

config VIDEO_MEDIATEK_IMGSENSOR_V2
	tristate "Mediatek Image Sensor Driver v2"
	help
	  MTK Linux driver for camera sensor v2.
	  This driver is used to configure MediaTek sensor module.
	  It include sensor power-on/off, scenario contorl.

config VIDEO_MEDIATEK_ISP_TINY
	bool "Minimize MTK ISP driver function"
	default n
	help
	  minimize the camera related ioctl.
```

## src/linux/drivers/misc/mediatek/Kconfig
```kconfig
source "drivers/misc/mediatek/chipinfo/Kconfig"
source "drivers/misc/mediatek/computervision/Kconfig"
source "drivers/misc/mediatek/display/Kconfig"
source "drivers/misc/mediatek/dprx/Kconfig"
source "drivers/misc/mediatek/dsi/Kconfig"
source "drivers/misc/mediatek/gpu/Kconfig"
source "drivers/misc/mediatek/imgproc/Kconfig"
source "drivers/misc/mediatek/ivp/Kconfig"
source "drivers/misc/mediatek/ldvt/Kconfig"
source "drivers/misc/mediatek/mmsys/Kconfig"
source "drivers/misc/mediatek/mm_sysram/Kconfig"
source "drivers/misc/mediatek/mutex/Kconfig"
source "drivers/misc/mediatek/pmic/Kconfig"
source "drivers/misc/mediatek/rbfc/Kconfig"
source "drivers/misc/mediatek/sbrc/Kconfig"
source "drivers/misc/mediatek/scp/Kconfig"
source "drivers/misc/mediatek/slicer/Kconfig"
source "drivers/misc/mediatek/timestamp/Kconfig"
source "drivers/misc/mediatek/top/Kconfig"
source "drivers/misc/mediatek/hal_tsp/Kconfig"
source "drivers/misc/mediatek/emi_ctrl/Kconfig"
```

## src/linux/drivers/misc/mediatek/chipinfo/Kconfig
```kconfig
config MTK_CHIPINFO
	tristate "Mediatek chip info driver"
	help
	 This is a driver to read chip information
	 like Main chip ID, Sub chip ID, HW ID and
	 SW ID.
```

## src/linux/drivers/misc/mediatek/computervision/Kconfig
```kconfig
config MTK_COMPUTERVISION
	tristate "MediaTek Computer Vision driver"
	help
	  Computer vision related hardware drivers.
	  This is an option to enable computer vision
	  including feature extraction and feature
	  matching for pose estimation.

config MTK_FE
	tristate "MediaTek FE driver"
	depends on MTK_COMPUTERVISION
	help
	  Feature Extraction hardware driver.
	  Divide picture into blocks, then calculate
	  Corner Response, find feature point with
	  MAX CR value in each block.

config MTK_FM
	tristate "MediaTek FM driver"
	depends on MTK_COMPUTERVISION
	help
	  Feature Matching hardware driver.
	  Using feature points extracted by fe,
	  define search range and search center,
	  calculate ZNCC value, and find a matching point
	  with max ZNCC value.
```

## src/linux/drivers/misc/mediatek/display/Kconfig
```kconfig
config MTK_DSC
	tristate "MediaTek dsc driver"
	help
	  MediaTek Linux Driver for DSC.
	  This driver is used to configure MediaTek DSC hardware module.
	  It includes stream format, frame size, data compression
	  and DSC core number setting.
```

## src/linux/drivers/misc/mediatek/dprx/Kconfig
```kconfig
config MTK_DPRX
	tristate "MediaTek DP-Rx Driver"
	help
	  MediaTek DP-Rx driver
	  Say 'Y' here to add MediaTek DP-Rx driver for mt3612,
	  it supports DisplayPort 1.4.
	  If unsure, say 'N'.

config MTK_DPRX_EDID
	bool "MediaTek DP-Rx Default EDID Loaded"
	depends on MTK_DPRX
	default y
	help
	  Say 'Y' here to load DP-Rx default EDID for mt3612,
	  it will load default EDID initially.
	  Say 'N' here not to load DP-Rx default EDID for mt3612,
	  it won't load default EDID initially.

config MTK_DPRX_HDCP_KEY
	bool "MediaTek DP-Rx HDCP Key Loaded"
	depends on MTK_DPRX
	default n
	help
	  Say 'Y' here to load DP-Rx HDCP Key for mt3612,
	  it will load HDCP Key.
	  Say 'N' here not to load DP-Rx HDCP Key for mt3612,
	  it won't load HDCP Key.

config MTK_DPRX_PHY_GCE
	bool "MediaTek DP-Rx PHY GCE Setting"
	depends on MTK_DPRX
	default y
	help
	  Say 'Y' here to enable DP-Rx PHY GCE setting for mt3612.
	  Say 'N' here not to enable DP-Rx PHY GCE setting for mt3612.
```

## src/linux/drivers/misc/mediatek/dsi/Kconfig
```kconfig
config MTK_DDDS
	tristate "MediaTek ddds driver"
	help
	  MediaTek Linux Driver for DDDS.
	  This driver is used to config MediaTek ddds hardware module.
	  DDDS can generate a reference clock to mipi_tx pll.
	  This reference clock will tracking HDMI/DP input hsync.

config MTK_DSI
	tristate "MediaTek dsi driver"
	help
	  MediaTek Linux Driver for DSI.
	  This driver is used to configure MediaTek dsi hardware module.
	  It include frame size, video & physical timing,
	  data format and lane setting.

config MTK_FRMTRK
	tristate "MediaTek frmtrk driver"
	help
	  MediaTek Linux Driver for FRMTRK.
	  This driver is used to configure MediaTek frmtrk hardware module.
	  It includes frame tracking target line, locking window size,
	  and enable/disable cross vsync function.
```
